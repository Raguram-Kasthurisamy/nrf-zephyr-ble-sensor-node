## Kconfig
```kconfig
# Author: Raguram Kasthurisamy

# Module Kconfig entry.
rsource "drivers/Kconfig"
```

## drivers/Kconfig
```kconfig
# Author: Raguram Kasthurisamy


menu "Project drivers"
rsource "sensor/Kconfig"
endmenu
```

## drivers/sensor/lis2dh12/Kconfig
```kconfig
# Author: Raguram Kasthurisamy


config RKS_LIS2DH12
	bool "LIS2DH12 / LIS3DH accelerometer over SPI (project driver)"
	default y
	depends on DT_HAS_RKS_LIS2DH12_ENABLED
	select SPI
	help
	  Driver for ST's LIS2DH12 and LIS3DH 3-axis accelerometers on SPI, written for this
	  project. Implements the Zephyr sensor API with an optional data-ready trigger.

config RKS_LIS2DH12_TRIGGER
	bool "Data-ready interrupt trigger"
	default y
	depends on RKS_LIS2DH12
	select GPIO
	help
	  Deliver SENSOR_TRIG_DATA_READY through the INT1 pin (irq-gpios). The handler runs in
	  the system work queue, not in interrupt context.
```

## dts/bindings/sensor/rks,lis2dh12.yaml
```yaml
# Author: Raguram Kasthurisamy
description: |
  ST LIS2DH12 / LIS3DH 3-axis accelerometer on SPI, handled by this project's own driver
  (drivers/sensor/lis2dh12). Both parts share the register map and report WHO_AM_I = 0x33.

compatible: "rks,lis2dh12"

include: [sensor-device.yaml, spi-device.yaml]

properties:
  irq-gpios:
    type: phandle-array
    description: INT1 pin, used for the data-ready trigger. Optional.

  odr-hz:
    type: int
    default: 10
    enum: [1, 10, 25, 50, 100, 200, 400]
    description: Output data rate in Hz.
```
